## br2-external/configs/hifive_unleashed_defconfig
```kconfig
# CCACHE

BR2_CCACHE=y

# Architecture
BR2_riscv=y
BR2_riscv_custom=y
BR2_RISCV_ISA_CUSTOM_RVM=y
BR2_RISCV_ISA_CUSTOM_RVF=y
BR2_RISCV_ISA_CUSTOM_RVD=y
BR2_RISCV_ISA_CUSTOM_RVC=y
BR2_RISCV_64=y
BR2_RISCV_ABI_LP64D=y

# System
BR2_SYSTEM_DHCP="eth0"
BR2_TARGET_GENERIC_GETTY=y
BR2_TARGET_GENERIC_GETTY_PORT="ttySIF0"

# Filesystem
BR2_TARGET_ROOTFS_CPIO=y

# Linux headers same as kernel, a 5.10 series
BR2_PACKAGE_HOST_LINUX_HEADERS_CUSTOM_5_10=y

# Kernel
BR2_LINUX_KERNEL=y
BR2_LINUX_KERNEL_CUSTOM_VERSION=y
BR2_LINUX_KERNEL_CUSTOM_VERSION_VALUE="5.10.178"

BR2_LINUX_KERNEL_USE_ARCH_DEFAULT_CONFIG=y
BR2_LINUX_KERNEL_CONFIG_FRAGMENT_FILES="${BR2_EXTERNAL_SIFIVE_RENODE_CI_PATH}/board/sifive/hifive-unleashed/linux.config.fragment"
BR2_LINUX_KERNEL_IMAGE=y
BR2_LINUX_KERNEL_DTS_SUPPORT=y
BR2_LINUX_KERNEL_INTREE_DTS_NAME="sifive/hifive-unleashed-a00"
BR2_LINUX_KERNEL_INSTALL_TARGET=y

# Bootloader
BR2_TARGET_OPENSBI=y
BR2_TARGET_OPENSBI_PLAT="sifive/fu540"
BR2_TARGET_OPENSBI_UBOOT_PAYLOAD=y
BR2_TARGET_UBOOT=y
BR2_TARGET_UBOOT_CUSTOM_VERSION=y
BR2_TARGET_UBOOT_CUSTOM_VERSION_VALUE="2021.01"
BR2_TARGET_UBOOT_BUILD_SYSTEM_KCONFIG=y
BR2_TARGET_UBOOT_BOARD_DEFCONFIG="sifive_fu540"
BR2_TARGET_UBOOT_NEEDS_DTC=y
BR2_TARGET_UBOOT_NEEDS_OPENSBI=y
BR2_TARGET_UBOOT_FORMAT_ITB=y
BR2_TARGET_UBOOT_SPL=y

# Host tools
BR2_PACKAGE_HOST_GENIMAGE=y
BR2_PACKAGE_HOST_UBOOT_TOOLS=y
BR2_PACKAGE_HOST_UBOOT_TOOLS_BOOT_SCRIPT=y
BR2_PACKAGE_HOST_UBOOT_TOOLS_BOOT_SCRIPT_SOURCE="board/sifive/hifive-unleashed/boot.cmd"

# Patches
BR2_GLOBAL_PATCH_DIR="${BR2_EXTERNAL_SIFIVE_RENODE_CI_PATH}/patches"

# Packages
BR2_PACKAGE_BUSYBOX_CONFIG_FRAGMENT_FILES="${BR2_EXTERNAL_SIFIVE_RENODE_CI_PATH}/package/busybox/busybox.config.fragment"
```

## br2-external/rootfs/configs/hifive_unleashed_defconfig
```kconfig
# CCACHE

BR2_CCACHE=y

# Architecture
BR2_riscv=y
BR2_riscv_custom=y
BR2_RISCV_ISA_CUSTOM_RVM=y
BR2_RISCV_ISA_CUSTOM_RVF=y
BR2_RISCV_ISA_CUSTOM_RVD=y
BR2_RISCV_ISA_CUSTOM_RVC=y
BR2_RISCV_64=y
BR2_RISCV_ABI_LP64D=y

# System
BR2_SYSTEM_DHCP="eth0"
BR2_TARGET_GENERIC_GETTY=y
BR2_TARGET_GENERIC_GETTY_PORT="ttySIF0"
BR2_ROOTFS_POST_IMAGE_SCRIPT="${BR2_EXTERNAL_SIFIVE_RENODE_CI_ROOTFS_PATH}/board/sifive/hifive-unleashed/post-image.sh"

# Linux headers same as kernel, a 5.10 series
BR2_PACKAGE_HOST_LINUX_HEADERS_CUSTOM_5_10=y

# Kernel
BR2_LINUX_KERNEL=n

# Bootloader
BR2_TARGET_OPENSBI=n
BR2_TARGET_UBOOT=n

# Host tools
BR2_PACKAGE_HOST_GENIMAGE=n
BR2_PACKAGE_HOST_UBOOT_TOOLS=n

# Packages

# video4linux packages
BR2_PACKAGE_LIBV4L=y
BR2_PACKAGE_LIBV4L_UTILS=y

# python
BR2_PACKAGE_PYTHON3=y
BR2_PACKAGE_PYTHON_PIP=y

# git
BR2_PACKAGE_GIT=y
BR2_PACKAGE_GIT_CRYPT=y
BR2_PACKAGE_OPENSSL=y
BR2_PACKAGE_LIBCURL=y
BR2_PACKAGE_LIBCURL_CURL=y
BR2_PACKAGE_CA_CERTIFICATES=y

# gpio packages
BR2_PACKAGE_LIBGPIOD=y
BR2_PACKAGE_LIBGPIOD_TOOLS=y

# i2c packages
BR2_PACKAGE_I2C_TOOLS=y
```

## image/arm32-default/configs/arm32_defconfig
```kconfig
# CCACHE

BR2_CCACHE=y

# Architecture
BR2_arm=y
BR2_cortex_a9=y
BR2_RELRO_NONE=y
BR2_TOOLCHAIN_BUILDROOT_GLIBC=y
BR2_TOOLCHAIN_BUILDROOT_CXX=y

# Linux headers same as kernel, a 6.1 series
BR2_PACKAGE_HOST_LINUX_HEADERS_CUSTOM_6_1=y

# Kernel
BR2_LINUX_KERNEL=n

# Bootloader
BR2_TARGET_OPENSBI=n
BR2_TARGET_UBOOT=n

# Host tools
BR2_PACKAGE_HOST_GENIMAGE=n
BR2_PACKAGE_HOST_UBOOT_TOOLS=n

# Packages

# video4linux packages
BR2_PACKAGE_LIBV4L=y
BR2_PACKAGE_LIBV4L_UTILS=y

# python
BR2_PACKAGE_PYTHON3=y
BR2_PACKAGE_PYTHON_PIP=y

# git
BR2_PACKAGE_GIT=y
BR2_PACKAGE_GIT_CRYPT=y
BR2_PACKAGE_OPENSSL=y
BR2_PACKAGE_LIBCURL=y
BR2_PACKAGE_LIBCURL_CURL=y
BR2_PACKAGE_CA_CERTIFICATES=y

# gpio packages
BR2_PACKAGE_LIBGPIOD=y
BR2_PACKAGE_LIBGPIOD_TOOLS=y

# i2c packages
BR2_PACKAGE_I2C_TOOLS=y
```

## kernel/arm32-zynq_7000/configs/zynq_7000_defconfig
```kconfig
# CCACHE

BR2_CCACHE=y

# Architecture
BR2_arm=y
BR2_cortex_a9=y
BR2_RELRO_NONE=y
BR2_TOOLCHAIN_BUILDROOT_GLIBC=y
BR2_TOOLCHAIN_BUILDROOT_CXX=y

# Filesystem
BR2_TARGET_ROOTFS_CPIO=y
# BR2_ROOTFS_DEVICE_CREATION_DYNAMIC_MDEV=y

# Kernel
BR2_LINUX_KERNEL=y
BR2_LINUX_KERNEL_CUSTOM_GIT=y
BR2_LINUX_KERNEL_CUSTOM_REPO_URL="https://github.com/Xilinx/linux-xlnx.git"
BR2_LINUX_KERNEL_CUSTOM_REPO_VERSION="tags/xilinx-v2023.1"

BR2_LINUX_KERNEL_DEFCONFIG="xilinx_zynq"
BR2_LINUX_KERNEL_CONFIG_FRAGMENT_FILES="${BR2_EXTERNAL_ZYNQ_RENODE_CI_PATH}/configs/linux.config.fragment"
BR2_LINUX_KERNEL_VMLINUX=y
BR2_LINUX_KERNEL_DTS_SUPPORT=y
BR2_LINUX_KERNEL_INTREE_DTS_NAME="zynq-test"
BR2_LINUX_KERNEL_CUSTOM_DTS_PATH="${BR2_EXTERNAL_ZYNQ_RENODE_CI_PATH}/patches/zynq-test.dts"
```
